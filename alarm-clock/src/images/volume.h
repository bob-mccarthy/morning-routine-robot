const uint8_t volumeWidth = 40;
const uint8_t volumeHeight = 14;
const uint8_t volumeX = 83;
const uint8_t volumeY = 2;
const uint8_t volume [] = {
	0x0,0x0,0x0,0x0,0x0,
	0x0,0x0,0x0,0x0,0x0,
	0x0,0x7f,0xff,0xff,0xf8,
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	0x0,0x0,0x0,0x0,0x0
};
void generateVolume(uint8_t *buffer, uint8_t height, uint8_t width, uint8_t percentage){
	uint16_t numPixels = height*width;
	int x,y,bit;
	int prevY = 0;

	for (int i = 0; i < numPixels; i++){
		x = i % width;
		y = i / width;
		if (i%8 == 0 ) {
			buffer[i/8] = 0;
		}
		bit = 0;
		if (y == 0 || x == 0 || x == width -1 || y == height - 1){
			bit = 1;
		}
		if (x < width * (percentage/100.0)){
			bit = 1;
		}
	
		buffer[i/8] |=  bit << (7 - (i%8));
		if (i%8 == 0 && i != 0) {
			Serial.printf("%X ", buffer[(i - 1)/8]);
		}
		if (prevY < y){
			Serial.println();
			prevY = y;
		}
	}
}